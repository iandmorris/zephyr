## dts/bindings/wifi/renesas,at-wifi-spi.yaml
```yaml
# Copyright (c) 2025 Renesas Electronics Corporation
# SPDX-License-Identifier: Apache-2.0

description: Renesas WiFi offload driver (AT commands over SPI)

compatible: "renesas,at-wifi-spi"

include:
  - "renesas,at-wifi.yaml"
  - "spi-device.yaml"

properties:
  int-gpios:
    required: true
    type: phandle-array
    description: |
      TODO
  boot-duration-ms:
    type: int
    description: |
      TODO
```

## dts/bindings/wifi/renesas,at-wifi-uart.yaml
```yaml
# Copyright (c) 2025 Renesas Electronics Corporation
# SPDX-License-Identifier: Apache-2.0

description: Renesas WiFi offload driver (AT commands over UART)

compatible: "renesas,at-wifi-uart"

include:
  - "renesas,at-wifi.yaml"
  - "uart-device.yaml"
```

## dts/bindings/wifi/renesas,at-wifi.yaml
```yaml
# Copyright (c) 2026 Renesas Electronics Corporation
# SPDX-License-Identifier: Apache-2.0

properties:
  reset-gpios:
    type: phandle-array
    description: |
      This gpio is used to reset the Wi-Fi device.

  reset-assert-duration-ms:
    type: int
    description: |
      Minimum duration to activate the reset-gpios pin.
      If not specified no delay beyond the code path execution time is guaranteed.
      TODO - this not supported on DA16200, only on RA6W1 so how to handle?
```

## dts/bindings/wifi/renesas,ra-at.yaml
```yaml
# Copyright (c) 2025 Renesas Electronics Corporation
# SPDX-License-Identifier: Apache-2.0

description: Renesas WiFi modem (AT Command)

compatible: "renesas,ra-at"

include: uart-device.yaml

properties:
  reset-gpios:
    type: phandle-array
```

## dts/bindings/wifi/renesas,ra-erpc.yaml
```yaml
# Copyright (c) 2025 Renesas Electronics Corporation
# SPDX-License-Identifier: Apache-2.0

description: Renesas WiFi modem (eRPC)

compatible: "renesas,ra-erpc"

include: uart-device.yaml
```

## dts/bindings/wifi/renesas,ra-rpc.yaml
```yaml
# Copyright (c) 2025 Renesas Electronics Corporation
# SPDX-License-Identifier: Apache-2.0

description: Renesas WiFi modem (RPC)

compatible: "renesas,ra-rpc"

include: uart-device.yaml
```

## dts/bindings/wifi/renesas,ra-wifi-erpc-spi.yaml
```yaml
# Copyright (c) 2025 Renesas Electronics Corporation
# SPDX-License-Identifier: Apache-2.0

description: Renesas WiFi modem (eRPC over SPI)

compatible: "renesas,ra-wifi-erpc-spi"

include: ["renesas,ra-erpc.yaml", "spi-controller.yaml"]

properties:
  int-gpios:
    type: phandle-array
    required: true
```

## dts/bindings/wifi/renesas,rrq-at.yaml
```yaml
# Copyright (c) 2025 Renesas Electronics Corporation
# SPDX-License-Identifier: Apache-2.0

description: Renesas RRQ61xxx WiFi modem (AT Commands)

compatible: "renesas,rrq-at"

include: uart-device.yaml

properties:
  reset-gpios:
    type: phandle-array
```

## samples/bluetooth/beacon/boards/mikroe_clicker_ra4m1.conf
```kconfig
CONFIG_BT_HCI=y
CONFIG_BT_HCI_ACL_FLOW_CONTROL=n
CONFIG_BT_CTLR=n
CONFIG_LOG=y
CONFIG_UART_CONSOLE=n
CONFIG_RTT_CONSOLE=y
CONFIG_USE_SEGGER_RTT=y
CONFIG_BT_HCI_CORE_LOG_LEVEL_DBG=y
```

## samples/sensor/dpm_polling/sample.yaml
```yaml
sample:
  description: Digital Power Monitor polling sample
  name: DPM polling sample
tests:
  sample.sensor.dpm_polling:
    build_only: true
    tags: sensors
    filter: dt_alias_exists("dpm0")
    integration_platforms:
      - ek_ra6m4
    platform_allow:
      - ek_ra6m4
    extra_args:
      - platform:ek_ra6m4:SHIELD="mikroe_power_monitor_2_click"
```

## soc/arm/renesas_ra/ra2e1/Kconfig.defconfig.r7fa2e1xxxxxx
```kconfig
# Copyright (c) 2024 Ian Morris
# SPDX-License-Identifier: Apache-2.0

if SOC_R7FA2E1A92DFM

config SOC
	default "r7fa2e1a92dfm"

endif # SOC_R7FA2E1A92DFM
```

## soc/arm/renesas_ra/ra2e1/Kconfig.defconfig.series
```kconfig
# Copyright (c) 2024 Ian Morris
# SPDX-License-Identifier: Apache-2.0

if SOC_SERIES_RA2E1

rsource "Kconfig.defconfig.r7fa2*"

config SOC_SERIES
	default "ra2e1"

config NUM_IRQS
	default 32

endif # SOC_SERIES_RA2E1
```

## soc/arm/renesas_ra/ra2e1/Kconfig.series
```kconfig
# Copyright (c) 2024 Ian Morris
# SPDX-License-Identifier: Apache-2.0

config SOC_SERIES_RA2E1
	bool "Renesas RA2E1"
	select ARM
	select CPU_CORTEX_M23
	select CPU_HAS_ARM_MPU
	select CPU_CORTEX_M_HAS_SYSTICK
	select DYNAMIC_INTERRUPTS
	select SOC_FAMILY_RA
	select TIMER_READS_ITS_FREQUENCY_AT_RUNTIME
	select XIP
```

## soc/arm/renesas_ra/ra2e1/Kconfig.soc
```kconfig
# Copyright (c) 2024 Ian Morris
# SPDX-License-Identifier: Apache-2.0

choice
	prompt "Renesas RA2E1 SoC Selection"
	depends on SOC_SERIES_RA2E1

config SOC_R7FA2E1A92DFM
	bool "R7FA2E1A92DFM"

endchoice
```

## soc/arm/renesas_ra/ra6m4/Kconfig.defconfig.r7fa6m4xxxxxx
```kconfig
# Copyright (c) 2023 TOKITA Hiroshi <tokita.hiroshi@fujitsu.com>
# SPDX-License-Identifier: Apache-2.0

if SOC_R7FA6M4AF3CFB

config SOC
	default "r7fa4m1abf3cfb"

endif # SOC_R7FA6M4AF3CFB
```

## soc/arm/renesas_ra/ra6m4/Kconfig.defconfig.series
```kconfig
# Copyright (c) 2023 Ian Morris
# SPDX-License-Identifier: Apache-2.0

if SOC_SERIES_RA6M4

rsource "Kconfig.defconfig.r7fa6*"

config SOC_SERIES
	default "ra6m4"

config NUM_IRQS
	default 32

endif # SOC_SERIES_RA6M4
```

## soc/arm/renesas_ra/ra6m4/Kconfig.series
```kconfig
# Copyright (c) 2023 Ian Morris
# SPDX-License-Identifier: Apache-2.0

config SOC_SERIES_RA6M4
	bool "Renesas RA6M4"
	select ARM
	select CPU_CORTEX_M33
	select CPU_HAS_ARM_MPU
	select CPU_CORTEX_M_HAS_SYSTICK
	select DYNAMIC_INTERRUPTS
	select SOC_FAMILY_RA
	select TIMER_READS_ITS_FREQUENCY_AT_RUNTIME
	select XIP
```

## soc/arm/renesas_ra/ra6m4/Kconfig.soc
```kconfig
# Copyright (c) 2023 Ian Morris
# SPDX-License-Identifier: Apache-2.0

choice
	prompt "Renesas RA6M4 SoC Selection"
	depends on SOC_SERIES_RA6M4

config SOC_R7FA6M4AF3CFB
	bool "R7FA6M4AF3CFB"

endchoice
```

## soc/arm/renesas_ra/ra6m5/Kconfig.defconfig.ra6m5_ahxxbg
```kconfig
# Copyright (c) 2024 Ian Morris
# SPDX-License-Identifier: Apache-2.0

if SOC_RA6M5_AHXXBG

config SOC
	default "RA6M5_AHXXBG"

config NUM_IRQS
	default 32

endif # SOC_RA6M5_AHXXBG
```

## soc/renesas/ra/ra6m5/Kconfig
```kconfig
# Copyright (c) 2024 Ian Morris
# SPDX-License-Identifier: Apache-2.0

config SOC_SERIES_RA6M5
	select ARM
	select CPU_CORTEX_M33
	select CPU_HAS_ARM_MPU
	select CPU_CORTEX_M_HAS_SYSTICK
	select DYNAMIC_INTERRUPTS
	select TIMER_READS_ITS_FREQUENCY_AT_RUNTIME
	select XIP

config SOC_OPTION_SETTING_MEMORY
	bool "Option Setting Memory"
	default y
```

## soc/renesas/ra/ra6m5/Kconfig.defconfig
```kconfig
# Copyright (c) 2024 Ian Morris
# SPDX-License-Identifier: Apache-2.0

if SOC_SERIES_RA6M5

config NUM_IRQS
	default 32

endif # SOC_SERIES_RA6M5
```

## soc/renesas/ra/ra6m5/Kconfig.soc
```kconfig
# Copyright (c) 2024 Ian Morris
# SPDX-License-Identifier: Apache-2.0

config SOC_SERIES_RA6M5
	bool
	select SOC_FAMILY_RENESAS_RA
	help
	  Renesas RA6M5

config SOC_R7FA6M5BH2CBG
	bool
	select SOC_SERIES_RA6M5
	help
	  R7FA6M5BH2CBG

config SOC_SERIES
	default "ra6m5" if SOC_SERIES_RA6M5

config SOC
	default "r7fa6m5bh2cbg" if SOC_R7FA6M5BH2CBG
```
