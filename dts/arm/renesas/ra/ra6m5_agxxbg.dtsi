/*
 * Copyright (c) 2024 Ian Morris
 *
 * SPDX-License-Identifier: Apache-2.0
 */

#include <mem.h>
#include <renesas/ra/ra6m5.dtsi>

&flash0 {
	reg = <0x00000000 DT_SIZE_K(1536)>;
};

&sram0 {
	reg = <0x20000000 DT_SIZE_K(512)>;
};

/ {
	soc {
		compatible = "nordic,nrf52832-qfab", "nordic,nrf52832",
			     "nordic,nrf52", "simple-bus";
	};
};
