## boards/arduino/portenta_c33/Kconfig.arduino_portenta_c33
```kconfig
# Copyright (c) 2024 Ian Morris
# SPDX-License-Identifier: Apache-2.0

config BOARD_ARDUINO_PORTENTA_C33
	select SOC_R7FA6M5BH2CBG
```

## boards/arduino/portenta_c33/Kconfig.board
```kconfig
# Copyright (c) 2024 Ian Morris
# SPDX-License-Identifier: Apache-2.0

config BOARD_ARDUINO_PORTENTA_C33
	bool "Arduino Portenta C33 Board"
	depends on SOC_RA6M5_BHXXBG
```

## boards/arduino/portenta_c33/board.yml
```yaml
# Copyright (c) 2024 Ian Morris
# SPDX-License-Identifier: Apache-2.0

board:
  name: arduino_portenta_c33
  vendor: arduino
  socs:
    - name: r7fa6m5bh2cbg
```

## boards/arm/ra2e1_ek/Kconfig.board
```kconfig
# Copyright (c) 2024 Ian Morris
# SPDX-License-Identifier: Apache-2.0

config BOARD_RA2E1_EK
	bool "Renesas EK-RA2E1 board"
	depends on SOC_R7FA2E1A92DFM
```

## boards/arm/ra2e1_ek/Kconfig.defconfig
```kconfig
# Copyright (c) 2024 Ian Morris
# SPDX-License-Identifier: Apache-2.0

if BOARD_RA2E1_EK

config BOARD
	default "ra2e1_ek"

endif #BOARD_RA2E1_EK
```

## boards/arm/ra2e1_ek/ra2e1_ek_defconfig
```kconfig
# Copyright (c) 2024 Ian Morris
# SPDX-License-Identifier: Apache-2.0

CONFIG_BOARD_RA2E1_EK=y
CONFIG_SOC_SERIES_RA2E1=y
CONFIG_SOC_R7FA2E1A92DFM=y

CONFIG_SYS_CLOCK_HW_CYCLES_PER_SEC=8000000

CONFIG_BUILD_OUTPUT_HEX=y

# enable uart driver
#CONFIG_SERIAL=y

# enable console
#CONFIG_CONSOLE=y
#CONFIG_UART_CONSOLE=y

# enable GPIO
CONFIG_GPIO=y

# enable pin controller
CONFIG_PINCTRL=y

# enable Clocks
CONFIG_CLOCK_CONTROL=y
```

## boards/arm/ra6m4_ek/Kconfig.board
```kconfig
# Copyright (c) 2023 Ian Morris
# SPDX-License-Identifier: Apache-2.0

config BOARD_RA6M4_EK
	bool "Renesas EK-RA6M4 board"
	depends on SOC_R7FA6M4AF3CFB
```

## boards/arm/ra6m4_ek/Kconfig.defconfig
```kconfig
# Copyright (c) 2023 Ian Morris
# SPDX-License-Identifier: Apache-2.0

if BOARD_RA6M4_EK

config BOARD
	default "ra6m4_ek"

endif #BOARD_RA6M4_EK
```

## boards/mikroe/mikromedia_4_stm32f2/Kconfig.mikroe_mikromedia_4_stm32f2_cap
```kconfig
# Copyright (c) 2024 Ian Morris
# SPDX-License-Identifier: Apache-2.0

config BOARD_MIKROE_MIKROMEDIA_4_STM32F2_CAP
	select SOC_STM32F207XX
```

## boards/mikroe/mikromedia_4_stm32f2/Kconfig.mikroe_mikromedia_4_stm32f2_res
```kconfig
# Copyright (c) 2024 Ian Morris
# SPDX-License-Identifier: Apache-2.0

config BOARD_MIKROE_MIKROMEDIA_4_STM32F2_RES
	select SOC_STM32F207XX
```

## boards/mikroe/mikromedia_4_stm32f2/board.yml
```yaml
boards:

  - name: mikroe_mikromedia_4_stm32f2_cap
    vendor: mikroe
    socs:
      - name: stm32f207xx

  - name: mikroe_mikromedia_4_stm32f2_res
    vendor: mikroe
    socs:
      - name: stm32f207xx
```

## boards/mikroe/mikromedia_4_stm32f2_cap/Kconfig.defconfig
```kconfig
# Copyright (c) 2024 Ian Morris
# SPDX-License-Identifier: Apache-2.0

if BOARD_MIKROE_MIKROMEDIA_4_STM32F2_CAP

config SPI_STM32_INTERRUPT
	default y
	depends on SPI

endif #BOARD_MIKROE_MIKROMEDIA_4_STM32F2_CAP
```

## boards/mikroe/mikromedia_4_stm32f2_cap/board.yml
```yaml
board:
  name: mikromedia_4_stm32f2_cap
  vendor: mikroe
  socs:
    - name: stm32f207xx
```

## boards/mikroe/mikromedia_5_stm32f7_cap_fpi/Kconfig.defconfig
```kconfig
# Copyright (c) 2024 Ian Morris
# SPDX-License-Identifier: Apache-2.0

if BOARD_MIKROMEDIA_5_STM32F7_CAP_FPI

config USB_DEVICE_STACK
	default y

config USB_CDC_ACM
	default SERIAL

endif #BOARD_MIKROMEDIA_5_STM32F7_CAP_FPI
```

## boards/mikroe/mikromedia_5_stm32f7_cap_fpi/Kconfig.mikromedia_5_stm32f7_cap_fpi
```kconfig
# Copyright (c) 2024 Ian Morris
# SPDX-License-Identifier: Apache-2.0

config BOARD_MIKROMEDIA_5_STM32F7_CAP_FPI
	select SOC_STM32F746XX
```

## boards/mikroe/mikromedia_5_stm32f7_cap_fpi/board.yml
```yaml
# Copyright (c) 2024 Ian Morris
# SPDX-License-Identifier: Apache-2.0

board:
  name: mikromedia_5_stm32f7_cap_fpi
  vendor: mikroe
  socs:
    - name: stm32f746xx
```

## boards/shields/connaxio_pmod_mikroshield/Kconfig.shield
```kconfig
# Copyright (c) 2024 Ian Morris
# SPDX-License-Identifier: Apache-2.0

config CONNAXIO_PMOD_MIKROSHIELD
	def_bool $(shields_list_contains,connaxio_pmod_mikroshield)
```

## boards/shields/mikroe_accel13_click/Kconfig.shield
```kconfig
# Copyright (c) 2023 Mark Olsson <mark@markolsson.se>
# SPDX-License-Identifier: Apache-2.0

config SHIELD_MIKROE_ACCEL13_CLICK_I2C
	def_bool $(shields_list_contains,mikroe_accel13_click_i2c)

config SHIELD_MIKROE_ACCEL13_CLICK_SPI
	def_bool $(shields_list_contains,mikroe_accel13_click_spi)
```

## boards/shields/mikroe_feather_click/Kconfig.shield
```kconfig
# Copyright (c) 2024 Ian Morris
# SPDX-License-Identifier: Apache-2.0

config MIKROE_FEATHER_CLICK
	def_bool $(shields_list_contains,mikroe_feather_click)
```

## boards/shields/mikroe_lp_wifi_click/Kconfig.defconfig
```kconfig
# Copyright (c) 2025 Renesas Electronics Corporation
# SPDX-License-Identifier: Apache-2.0

if SHIELD_MIKROE_LP_WIFI_CLICK

if WIFI_AT_WIFI

choice WIFI_AT_WIFI_SOC_VARIANT
	default WIFI_AT_WIFI_SOC_DA16XXX

endchoice

endif	# WIFI_AT_WIFI

endif	# SHIELD_MIKROE_LP_WIFI_CLICK
```

## boards/shields/mikroe_lp_wifi_click/Kconfig.shield
```kconfig
# Copyright (c) 2025 Renesas Electronics Corporation
# SPDX-License-Identifier: Apache-2.0

config SHIELD_MIKROE_LP_WIFI_CLICK
	def_bool $(shields_list_contains,mikroe_lp_wifi_click)
```

## boards/shields/mikroe_oled_c_click/Kconfig.defconfig
```kconfig
# Copyright (c) 2026 Ian Morris
# SPDX-License-Identifier: Apache-2.0

if SHIELD_MIKROE_OLED_C_CLICK

if DISPLAY

if LVGL

config LV_COLOR_16_SWAP
	default y

config LV_Z_BITS_PER_PIXEL
	default 16

choice LV_COLOR_DEPTH
	default LV_COLOR_DEPTH_16
endchoice

endif # LVGL

# Required to enable boost voltage regulator
config REGULATOR
	default y

endif # DISPLAY

endif # SHIELD_MIKROE_OLED_C_CLICK
```

## boards/shields/mikroe_oled_c_click/Kconfig.shield
```kconfig
# Copyright (c) 2026 Ian Morris
# SPDX-License-Identifier: Apache-2.0

config SHIELD_MIKROE_OLED_C_CLICK
	def_bool $(shields_list_contains,mikroe_oled_c_click)
```

## boards/shields/mikroe_oled_w_click/Kconfig.defconfig
```kconfig
# Copyright (c) 2025 Ian Morris
# SPDX-License-Identifier: Apache-2.0

if DISPLAY

if LVGL

config LV_Z_VDB_SIZE
	default 64

config LV_Z_BITS_PER_PIXEL
	default 1

choice LV_COLOR_DEPTH
	default LV_COLOR_DEPTH_1
endchoice

endif # LVGL

endif # DISPLAY
```

## boards/shields/mikroe_oled_w_click/Kconfig.shield
```kconfig
# Copyright (c) 2025 Ian Morris
# SPDX-License-Identifier: Apache-2.0

config SHIELD_MIKROE_OLED_W_CLICK
	def_bool $(shields_list_contains,mikroe_oled_w_click)

config SHIELD_MIKROE_OLED_W_CLICK_SPI
	def_bool $(shields_list_contains,mikroe_oled_w_click_spi)
```
