/*
 * Copyright (c) 2025 Ian Morris
 *
 * SPDX-License-Identifier: Apache-2.0
 */

/ {
	chosen {
		zephyr,display = &mi9639bo_w_96x39_spi;
	};
};

&mikrobus_spi {
	status = "okay";

	mi9639bo_w_96x39_spi: ssd1306@0 {
		compatible = "solomon,ssd1306fb";
		reg = <0x0>;
		spi-max-frequency = <10000000>;
		data_cmd-gpios = <&mikrobus_header 6 GPIO_ACTIVE_LOW>;
		reset-gpios = <&mikrobus_header 1 GPIO_ACTIVE_LOW>;

		width = <96>;
		height = <39>;

		segment-offset = <0>;
		page-offset = <0>;
		display-offset = <0>;
		multiplex-ratio = <38>;
		prechargep = <0x22>;
		ready-time-ms = <10>;
	};
};
