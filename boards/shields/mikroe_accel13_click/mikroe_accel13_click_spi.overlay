/*
 * Copyright (c) 2025 Ian Morris
 *
 * SPDX-License-Identifier: Apache-2.0
 */

/ {
	aliases {
		accel0 = &iis2dlpc_mikroe_accel13_click;
	};
};

&mikrobus_spi {
	status = "okay";
	cs-gpios = <&mikrobus_header 2 GPIO_ACTIVE_LOW>;

	iis2dlpc_mikroe_accel13_click: iis2dlpc@0 {
		compatible = "st,iis2dlpc";
		reg = <0>;
		spi-max-frequency = <1000000>;
		status = "okay";
	};
};
