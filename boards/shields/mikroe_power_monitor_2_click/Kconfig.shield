## dts/bindings/bluetooth/renesas,bt-hci-da1453x.yaml
```yaml
# Copyright 2024 Ian Morris
# SPDX-License-Identifier: Apache-2.0

description: Bluetooth HCI for Renesas DA1453x based controller

compatible: "renesas,bt-hci-da1453x"

include: base.yaml

properties:
  bt-reset-gpios:
    type: phandle-array
    required: true
```
