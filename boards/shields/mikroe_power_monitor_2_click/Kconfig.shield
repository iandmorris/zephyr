## boards/shields/mikroe_power_monitor_2_click/Kconfig.shield
```kconfig
# SPDX-FileCopyrightText: Copyright (c) 2026 Ian Morris
# SPDX-License-Identifier: Apache-2.0

config SHIELD_MIKROE_POWER_MONITOR_2_CLICK
	def_bool $(shields_list_contains,mikroe_power_monitor_2_click)
```

## boards/shields/mikroe_temp_hum_17_click/Kconfig.shield
```kconfig
# Copyright (c) 2024 Ian Morris
# SPDX-License-Identifier: Apache-2.0

config SHIELD_MIKROE_TEMP_HUM_17_CLICK
	def_bool $(shields_list_contains,mikroe_temp_hum_17_click)
```

## boards/shields/renesas_qciot_hs4001pocz/Kconfig.shield
```kconfig
# Copyright (c) 2024 Ian Morris
# SPDX-License-Identifier: Apache-2.0

config SHIELD_RENESAS_QCIOT_HS4001POCZ
	def_bool $(shields_list_contains,renesas_qciot_hs4001pocz)
```

## boards/shields/renesas_qciot_rrq61051evz/Kconfig.defconfig
```kconfig
# Copyright (c) 2025 Renesas Electronics Corporation
# SPDX-License-Identifier: Apache-2.0

if SHIELD_RENESAS_QCIOT_RRQ61051EVZ || \
	SHIELD_RENESAS_QCIOT_RRQ61051EVZ_MIKROBUS_SPI || \
	SHIELD_RENESAS_QCIOT_RRQ61051EVZ_PMOD_UART

if WIFI_AT_WIFI

choice WIFI_AT_WIFI_SOC_VARIANT
	default WIFI_AT_WIFI_SOC_RA6WX

endchoice

endif	# WIFI_AT_WIFI

endif	# SHIELD_RENESAS_QCIOT_RRQ61051EVZ || \
	# SHIELD_RENESAS_QCIOT_RRQ61051EVZ_MIKROBUS_SPI || \
	# SHIELD_RENESAS_QCIOT_RRQ61051EVZ_PMOD_UART
```

## boards/shields/renesas_qciot_rrq61051evz/Kconfig.shield
```kconfig
# Copyright (c) 2025 Renesas Electronics Corporation
# SPDX-License-Identifier: Apache-2.0

config SHIELD_RENESAS_QCIOT_RRQ61051EVZ
	def_bool $(shields_list_contains,renesas_qciot_rrq61051evz)

config SHIELD_RENESAS_QCIOT_RRQ61051EVZ_MIKROBUS_SPI
	def_bool $(shields_list_contains,renesas_qciot_rrq61051evz_mikrobus_spi)

config SHIELD_RENESAS_QCIOT_RRQ61051EVZ_MIKROBUS_UART
	def_bool $(shields_list_contains,renesas_qciot_rrq61051evz_mikrobus_uart)

config SHIELD_RENESAS_QCIOT_RRQ61051EVZ_PMOD
	def_bool $(shields_list_contains,renesas_qciot_rrq61051evz_pmod)
```

## boards/shields/renesas_ra6w1/Kconfig.shield
```kconfig
# Copyright (c) 2025 Renesas Electronics Corporation
# SPDX-License-Identifier: Apache-2.0

config SHIELD_RENESAS_RA6W1
	def_bool $(shields_list_contains,renesas_ra6W1)
```

## boards/shields/renesas_us082_hs3001evz/Kconfig.shield
```kconfig
# Copyright (c) 2024 Ian Morris
# SPDX-License-Identifier: Apache-2.0

config SHIELD_RENESAS_US082_HS3001EVZ
	def_bool $(shields_list_contains,renesas_us082_hs3001evz)
```

## boards/shields/renesas_us159_da16200mevz/Kconfig.defconfig
```kconfig
# Copyright (c) 2025 Renesas Electronics Corporation
# SPDX-License-Identifier: Apache-2.0

if SHIELD_RENESAS_US159_DA16200MEVZ

if WIFI_AT_WIFI

choice WIFI_AT_WIFI_SOC_VARIANT
	default WIFI_AT_WIFI_SOC_DA16XXX

endchoice

endif	# WIFI_AT_WIFI

endif	# SHIELD_RENESAS_US159_DA16200MEVZ
```

## boards/shields/renesas_us159_da16200mevz/Kconfig.shield
```kconfig
# Copyright (c) 2025 Renesas Electronics Corporation
# SPDX-License-Identifier: Apache-2.0

config SHIELD_RENESAS_US159_DA16200MEVZ
	def_bool $(shields_list_contains,renesas_us159_da16200mevz)
```

## boards/shields/seeed_grove_bme280/Kconfig.shield
```kconfig
# Copyright (c) 2026 Ian Morris
# SPDX-License-Identifier: Apache-2.0

config SHIELD_SEEED_GROVE_BME280
	def_bool $(shields_list_contains,seeed_grove_bme280)
```

## boards/silabs/explorer_kits/bg22_ek4108a/Kconfig.bg22_ek4108a
```kconfig
# Copyright (c) 2024 Ian Morris
# SPDX-License-Identifier: Apache-2.0

config BOARD_BG22_EK4108A
	select SOC_PART_NUMBER_EFR32BG22C224F512IM40
```

## boards/silabs/explorer_kits/bg22_ek4108a/board.yml
```yaml
# Copyright (c) 2024 Ian Morris
# SPDX-License-Identifier: Apache-2.0

board:
  name: bg22_ek4108a
  vendor: silabs
  socs:
    - name: efr32bg22c224f512im40
```

## boards/sparkfun/thing_plus_ra6m5/Kconfig.sparkfun_thing_plus_ra6m5
```kconfig
# Copyright (c) 2025 Ian Morris
# SPDX-License-Identifier: Apache-2.0

config BOARD_SPARKFUN_THING_PLUS_RA6M5
	select SOC_R7FA6M5AH3CFP
```

## boards/sparkfun/thing_plus_ra6m5/board.yml
```yaml
# Copyright (c) 2025 Ian Morris
# SPDX-License-Identifier: Apache-2.0

board:
  name: sparkfun_thing_plus_ra6m5
  full_name: Thing Plus RA6M5
  vendor: sparkfun
  socs:
    - name: r7fa6m5ah3cfp
```

## boards/sparkfun/thing_plus_ra6m5/sparkfun_thing_plus_ra6m5_defconfig
```kconfig
# Copyright (c) 2025 Ian Morris
# SPDX-License-Identifier: Apache-2.0

# Enable console
CONFIG_SERIAL=y
CONFIG_UART_CONSOLE=y
CONFIG_UART_INTERRUPT_DRIVEN=y
CONFIG_CONSOLE=y

# Enable GPIO
CONFIG_GPIO=y
```

## drivers/sensor/hs300x/Kconfig
```kconfig
# Renesas HS300x temperature and humidity sensor configuration options

# Copyright (c) 2023 Ian Morris
# SPDX-License-Identifier: Apache-2.0

config HS300X
	bool "HS300x Temperature and Humidity Sensor"
	default y
	depends on DT_HAS_RENESAS_HS300X_ENABLED
	select I2C
	help
	  Enable driver for HS300x temperature and humidity sensors.

if HS300X

config HS300X_GPIO_POWER
	bool "HS300x GPIO Power"
	default n
	help
	  HS300x is powered via a GPIO, allowing measurement resolution to be configured.

endif #HS300X
```

## drivers/sensor/renesas/hs40xx/Kconfig
```kconfig
# Renesas HS40xx temperature and humidity sensor configuration options

# Copyright (c) 2024 Ian Morris
# SPDX-License-Identifier: Apache-2.0

config HS40XX
	bool "HS40xx Temperature and Humidity Sensor"
	default y
	depends on DT_HAS_RENESAS_HS40XX_ENABLED
	select I2C
	help
	  Enable driver for HS40xx temperature and humidity sensors.
```

## drivers/wifi/ra_rpc/Kconfig.ra_rpc
```kconfig
# Copyright (c) 2025 Renesas Electronics Corporation
# SPDX-License-Identifier: Apache-2.0

menuconfig WIFI_RA_RPC
	bool "Renesas RA RPC support"
	select WIFI_OFFLOAD
	select NET_L2_WIFI_MGMT

	# C++ Language Support
	#select CPP
	#default STD_CPP20
	#default GLIBCXX_LIBCPP
	#default NEWLIB_LIBC

	# eRPC
	#select ERPC
	#select ERPC_TRANSPORT_UART

	# C++ Language Support
	#select CPP
	#select REQUIRES_FULL_LIBC
	# eRPC
	#select ERPC
	#select ERPC_TRANSPORT_UART
	default y

if WIFI_RA_RPC

config WIFI_RA_RPC_WORKQ_STACK_SIZE
	int "Stack size for the esp driver work queue"
	default 2048
	help
	  This stack is used by the work queue to pass off net_pkt data
	  to the rest of the network stack, letting the rx thread continue
	  processing data.

config WIFI_RA_RPC_WORKQ_THREAD_PRIORITY
	int "Priority of work queue thread"
	default 7
	help
	  Priority of thread used for processing driver work queue items.

config WIFI_RA_RPC_MAX_BBS_COUNT
	int "TODO!!!"
	default 80
	help
	  TODO!!!!

endif # WIFI_RA_RPC
```

## drivers/wifi/renesas/at_wifi/Kconfig.at_wifi
```kconfig
# Copyright (c) 2026 Renesas Electronics Corporation
# SPDX-License-Identifier: Apache-2.0

# TODO - move all uart selections under uart transport selected
# TODO - remove all SPI items
# TODO - rmove all items related to RA6W1

menuconfig WIFI_RENESAS_AT_WIFI
	bool "Renesas RA AT Command support"
	default y
	depends on DT_HAS_RENESAS_AT_WIFI_UART_ENABLED || DT_HAS_RENESAS_AT_WIFI_SPI_ENABLED
	select WIFI_RENESAS_AT_WIFI_TRANSPORT_UART if DT_HAS_RENESAS_AT_WIFI_UART_ENABLED
	select WIFI_RENESAS_AT_WIFI_TRANSPORT_SPI if DT_HAS_RENESAS_AT_WIFI_SPI_ENABLED
	select MODEM
	select MODEM_CONTEXT
	select MODEM_CMD_HANDLER
	select WIFI_OFFLOAD
	select NET_L2_WIFI_MGMT
	select NET_OFFLOAD
	select NET_SOCKETS_OFFLOAD
	select NET_SOCKETS
	help
	  Enable Renesas AT Command offloaded WiFi driver.

if WIFI_RENESAS_AT_WIFI

choice WIFI_RENESAS_AT_WIFI_SOC_VARIANT
	bool "Renesas Wi-Fi SoC variant selection"
	default WIFI_RENESAS_AT_WIFI_SOC_DA16XXX

config WIFI_RENESAS_AT_WIFI_SOC_DA16XXX
	bool "DA16xxx SoC Family"
	help
	  Enable support for Renesas DA16xxx Wi-Fi SoC's

config WIFI_RENESAS_AT_WIFI_SOC_RA6WX
	bool "RA6Wx SoC Family"
	help
	  Enable support for Renesas RA6Wx Wi-Fi SoC's

endchoice

config WIFI_RENESAS_AT_WIFI_TRANSPORT_UART
	bool "Enable AT UART transport"
	select MODEM_IFACE_UART
	imply UART_USE_RUNTIME_CONFIGURE
	help
	  When enabled, AT will include UART transport layer.

config WIFI_RENESAS_AT_WIFI_TRANSPORT_SPI
	bool "Enable AT SPI transport"
	select SPI
	help
	  When enabled, AT will include SPI transport layer.

config WIFI_RENESAS_AT_WIFI_MODEM_RING_BUF_SIZE
	int "Modem ring buffer size"
	default 1024
	help
	  Ring buffer size used by modem UART interface handler.

config WIFI_RENESAS_AT_WIFI_MODEM_RX_BUF_COUNT
	int "Modem RX buffer count"
	default 30
	help
	  Number of preallocated RX buffers used by modem command handler.

config WIFI_RENESAS_AT_WIFI_MODEM_RX_BUF_SIZE
	int "Modem RX buffer size"
	default 256
	help
	  Size of preallocated RX buffers used by modem command handler.

config WIFI_RENESAS_AT_WIFI_RX_STACK_SIZE
	int "Stack size for the Renesas RRQ AT wifi driver RX thread"
	default 1024
	help
	  This stack is used by the Renesas RRQ AT RX thread.

config WIFI_RENESAS_AT_WIFI_RX_THREAD_PRIORITY
	int "Priority of RX thread"
	default 7
	help
	  Priority of thread used for processing RX data.

config WIFI_RENESAS_AT_WIFI_WORKQ_STACK_SIZE
	int "Stack size for the esp driver work queue"
	default 2048
	help
	  This stack is used by the work queue to pass off net_pkt data
	  to the rest of the network stack, letting the rx thread continue
	  processing data.

config WIFI_RENESAS_AT_WIFI_WORKQ_THREAD_PRIORITY
	int "Priority of work queue thread"
	default 7
	help
	  Priority of thread used for processing driver work queue items.

config WIFI_RENESAS_AT_WIFI_RESET_TIMEOUT
	int "Reset timeout"
	default 3000
	help
	  TODO

# TODO - only need this if SPI transport is used
config WIFI_RENESAS_AT_WIFI_HEAP_SIZE
    int "Heap size for driver"
    default 4096
    help
      TODO

endif # WIFI_RENESAS_AT_WIFI
```

## drivers/wifi/renesas/ra_at/Kconfig.ra_at
```kconfig
# Copyright (c) 2025 Renesas Electronics Corporation
# SPDX-License-Identifier: Apache-2.0

menuconfig WIFI_RA_AT
	bool "Renesas RA AT Command support"
	default y
	depends on DT_HAS_RENESAS_RA_AT_ENABLED
	select MODEM
	select MODEM_CONTEXT
	select MODEM_CMD_HANDLER
	select MODEM_IFACE_UART
	select NET_L2_WIFI_MGMT
	select WIFI_OFFLOAD
	imply UART_USE_RUNTIME_CONFIGURE
	help
	  Enable Renesas RA AT Command offloaded WiFi driver supported on
	  RA6W1 devices.

if WIFI_RA_AT

config WIFI_RA_AT_MODEM_RING_BUF_SIZE
	int "Modem ring buffer size"
	default 1024
	help
	  Ring buffer size used by modem UART interface handler.

config WIFI_RA_AT_MODEM_RX_BUF_COUNT
	int "Modem RX buffer count"
	default 30
	help
	  Number of preallocated RX buffers used by modem command handler.

config WIFI_RA_AT_MODEM_RX_BUF_SIZE
	int "Modem RX buffer size"
	default 128
	help
	  Size of preallocated RX buffers used by modem command handler.

config WIFI_RA_AT_RX_STACK_SIZE
	int "Stack size for the Renesas RRQ AT wifi driver RX thread"
	default 1024
	help
	  This stack is used by the Renesas RRQ AT RX thread.

config WIFI_RA_AT_RX_THREAD_PRIORITY
	int "Priority of RX thread"
	default 7
	help
	  Priority of thread used for processing RX data.

config WIFI_RA_AT_WORKQ_STACK_SIZE
	int "Stack size for the esp driver work queue"
	default 2048
	help
	  This stack is used by the work queue to pass off net_pkt data
	  to the rest of the network stack, letting the rx thread continue
	  processing data.

config WIFI_RA_AT_WORKQ_THREAD_PRIORITY
	int "Priority of work queue thread"
	default 7
	help
	  Priority of thread used for processing driver work queue items.

endif # WIFI_RA_AT
```

## drivers/wifi/renesas/ra_erpc/Kconfig.ra_erpc
```kconfig
# Copyright (c) 2025 Renesas Electronics Corporation
# SPDX-License-Identifier: Apache-2.0

menuconfig WIFI_RA_ERPC
	bool "Renesas RA eRPC support"
	default y
	depends on DT_HAS_RENESAS_RA_ERPC_ENABLED
	select WIFI_OFFLOAD
	select NET_L2_WIFI_MGMT
	select NET_OFFLOAD
	select NET_SOCKETS_OFFLOAD
	select NET_SOCKETS

	# C++ Language Support (required by eRPC module)
	select CPP

	# eRPC
	select ERPC
	select ERPC_TRANSPORT_UART
    select ERPC_ARBITRATED_CLIENT

if WIFI_RA_ERPC

choice LIBC_IMPLEMENTATION
	default NEWLIB_LIBC
endchoice

choice LIBCPP_IMPLEMENTATION
	default GLIBCXX_LIBCPP
endchoice

config HEAP_MEM_POOL_ADD_SIZE_RA_ERPC_WIFI
	int "TODO add something here and check the size below (too big/small?)"
	default 16384
	help
	  Make sure there is a minimal heap available for Wi-Fi driver.

config WIFI_RA_ERPC_WORKQ_STACK_SIZE
	int "Stack size for the esp driver work queue"
	default 2048
	help
	  TODO - add description.

config WIFI_RA_ERPC_WORKQ_THREAD_PRIORITY
	int "Priority of work queue thread"
	default 7
	help
	  Priority of thread used for processing driver work queue items.

config WIFI_RA_ERPC_SERVER_THREAD_STACK_SIZE
	int "Stack size for the eRPC server thread"
	default 1024
	help
	  TODO - add description.

config WIFI_RA_ERPC_SERVER_THREAD_PRIORITY
	int "Priority of eRPC server thread"
	default 5
	help
	  TODO - add description.

config WIFI_RA_ERPC_MAX_BBS_COUNT
	int "TODO!!!"
	default 80
	help
	  TODO - add description.

config WIFI_RA_ERPC_SOFTAP_SUPPORT
	bool "Wi-Fi SoftAP Support"
	help
	  Option to enable Wi-Fi SoftAP functions in the Wi-Fi driver.

endif # WIFI_RA_ERPC
```

## drivers/wifi/renesas/ra_rpc/Kconfig.ra_rpc
```kconfig
# Copyright (c) 2025 Renesas Electronics Corporation
# SPDX-License-Identifier: Apache-2.0

menuconfig WIFI_RA_RPC
	bool "Renesas RA RPC support"
	default y
	depends on DT_HAS_RENESAS_RA_RPC_ENABLED
	select WIFI_OFFLOAD
	select NET_L2_WIFI_MGMT

	# C++ Language Support (required by eRPC module)
	select CPP

	# eRPC
	select ERPC
	select ERPC_TRANSPORT_UART

if WIFI_RA_RPC

choice LIBC_IMPLEMENTATION
	default NEWLIB_LIBC
endchoice

choice LIBCPP_IMPLEMENTATION
	default GLIBCXX_LIBCPP
endchoice

config HEAP_MEM_POOL_ADD_SIZE_RA_RPC_WIFI
	int "TODO add something here and check the size below (too big/small?)"
	default 16384
	help
	  Make sure there is a minimal heap available for Wi-Fi driver.

config WIFI_RA_RPC_WORKQ_STACK_SIZE
	int "Stack size for the esp driver work queue"
	default 2048
	help
	  TODO - add description.

config WIFI_RA_RPC_WORKQ_THREAD_PRIORITY
	int "Priority of work queue thread"
	default 7
	help
	  Priority of thread used for processing driver work queue items.

config WIFI_RA_RPC_MAX_BBS_COUNT
	int "TODO!!!"
	default 80
	help
	  TODO - add description.

config WIFI_RA_RPC_SOFTAP_SUPPORT
	bool "Wi-Fi SoftAP Support"
	help
	  Option to enable Wi-Fi SoftAP functions in the Wi-Fi driver.

endif # WIFI_RA_RPC
```

## drivers/wifi/rrq_at/Kconfig.rrq_at
```kconfig
# Copyright (c) 2025 Renesas Electronics Corporation
# SPDX-License-Identifier: Apache-2.0

menuconfig WIFI_RRQ_AT
	bool "Renesas RRQ AT Command support"
	default y
	depends on DT_HAS_RENESAS_RRQ_AT_ENABLED
	select MODEM
	select MODEM_CONTEXT
	select MODEM_CMD_HANDLER
	select MODEM_IFACE_UART
	select NET_L2_WIFI_MGMT
	select WIFI_OFFLOAD
	imply UART_USE_RUNTIME_CONFIGURE
	help
	  Enable Renesas RRQ AT Command offloaded WiFi driver supported on
	  RRQ61xxx devices.

if WIFI_RRQ_AT

config WIFI_RRQ_AT_MODEM_RING_BUF_SIZE
	int "Modem ring buffer size"
	default 1024
	help
	  Ring buffer size used by modem UART interface handler.

config WIFI_RRQ_AT_MODEM_RX_BUF_COUNT
	int "Modem RX buffer count"
	default 30
	help
	  Number of preallocated RX buffers used by modem command handler.

config WIFI_RRQ_AT_MODEM_RX_BUF_SIZE
	int "Modem RX buffer size"
	default 128
	help
	  Size of preallocated RX buffers used by modem command handler.

config WIFI_RRQ_AT_RX_STACK_SIZE
	int "Stack size for the Renesas RRQ AT wifi driver RX thread"
	default 1024
	help
	  This stack is used by the Renesas RRQ AT RX thread.

config WIFI_RRQ_AT_RX_THREAD_PRIORITY
	int "Priority of RX thread"
	default 7
	help
	  Priority of thread used for processing RX data.

endif # WIFI_RRQ_AT
```
