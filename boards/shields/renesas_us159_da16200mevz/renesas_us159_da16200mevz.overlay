/*
 * Copyright (c) 2026 Renesas Electronics Corporation
 *
 * SPDX-License-Identifier: Apache-2.0
 */

&pmod_serial {
	status = "okay";
	current-speed = <115200>;

	da16200 {
		compatible = "renesas,at-wifi-uart";
		status = "okay";
	};
};
