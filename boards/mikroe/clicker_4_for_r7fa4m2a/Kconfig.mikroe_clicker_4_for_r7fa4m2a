## boards/mikroe/clicker_4_for_r7fa4m2a/Kconfig.mikroe_clicker_4_for_r7fa4m2a
```kconfig
# Copyright (c) 2026 Ian Morris
# SPDX-License-Identifier: Apache-2.0

config BOARD_MIKROE_CLICKER_4_FOR_R7FA4M2A
	select SOC_R7FA4M2AD3CFP
```

## boards/mikroe/clicker_4_for_r7fa4m2a/board.yml
```yaml
# Copyright (c) 2026 Ian Morris
# SPDX-License-Identifier: Apache-2.0

board:
  name: mikroe_clicker_4_for_r7fa4m2a
  full_name: Clicker 4 for R7FA4M2A
  vendor: mikroe
  socs:
    - name: r7fa4m2ad3cfp
```

## boards/mikroe/clicker_4_for_r7fa4m2a/mikroe_clicker_4_for_r7fa4m2a_defconfig
```kconfig
# Copyright (c) 2026 Ian Morris
# SPDX-License-Identifier: Apache-2.0

# Enable GPIO
CONFIG_GPIO=y

# Enable console
CONFIG_SERIAL=y
CONFIG_CONSOLE=y
CONFIG_UART_CONSOLE=y

CONFIG_USB_DEVICE_STACK_NEXT=y
CONFIG_CDC_ACM_SERIAL_INITIALIZE_AT_BOOT=y
```
