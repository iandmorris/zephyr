/*
 * Copyright (c) 2024 Ian Morris
 *
 * SPDX-License-Identifier: Apache-2.0
 */

 /dts-v1/;
 #include "mikroe_mikromedia_4_stm32f2_common.dtsi"

/ {
	model = "Mikroe Mikromedia 4 for STM32F2 Capacitive";
};
